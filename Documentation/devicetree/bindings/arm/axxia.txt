## Documentation/devicetree/bindings/arm/axxia.txt
```
INTEL Axxia AXM55xx device tree bindings

Boards using the AXM55xx SoC need to have the following properties:

Required root node property:

  - compatible = "axxia,axm5516"

Boards:

  LSI AXM5516 Validation board (Amarillo)
	compatible = "axxia,axm5516-amarillo", "axxia,axm5516"
```

## Documentation/devicetree/bindings/arm/axxia/edac.txt
```
Axxia Error Detection & Correction [EDAC]
The EDAC accesses a range of registers in the memory controllers.

Required properties:
- compatible : should contain "intel,smmon"
- interrupts : Should contain the SYSMEM controller IRQ

Example:
	sm0: sm0@00220000 {
	     compatible = "intel,smmon";
             reg = <0 0x00220000 0 0x1000>;
             syscon = <&syscon>;
             interrupts = <0 238 4>;
	};
```

## Documentation/devicetree/bindings/arm/axxia/edac_cm.txt
```
Axxia Error Detection & Correction [EDAC]
The EDAC accesses a range of registers in the memory controllers.

Required properties:
- compatible : should contain "intel,cmmon"
- interrupts : Should contain the CMEM controller IRQ

Example:
       cm0: cm0@00080009 {
            compatible = "intel,cmmon";
             reg = <0 0x0080009 0 0x1000>;
             syscon = <&syscon>;
             interrupts = <0 233 4>;
       };

       cm1: cm1@00090009 {
            compatible = "intel,cmmon";
             reg = <0 0x0090009 0 0x1000>;
             syscon = <&syscon>;
             interrupts = <0 234 4>;
       };
```

## Documentation/devicetree/bindings/arm/axxia/edac_cpu.txt
```
Axxia Error Detection & Correction [EDAC]
The EDAC accesses ARM v7/v8 CPUMERRSR_EL1 register data.

Required properties:
- compatible 	: should contain "intel,cortex-a57-cpu" for AXM56xx
		: should contain "lsi,cortex-a15-cpu" for AXM55xx
- syscon	: should referernce syscon node for both 55xx/56xx

Example:
	edac_cpu: edac_cpu {
	        compatible = "intel,cortex-a57-cpu";
	        syscon = <&syscon>;
	        status = "disabled";
	};
```

## Documentation/devicetree/bindings/arm/axxia/edac_l1.txt
```
Axxia Error Detection & Correction [EDAC]
The EDAC accesses ARM v7/v8 L2MERRSR_EL1 register data.

Required properties:
- compatible	: should contain "intel,cortex-a53-cpu" for AXM67xx
		: should contain "intel,cortex-a57-cpu" for AXM56xx
		: should contain "axxia,cortex-a15-cpu" for AXM55xx
- syscon	: should referernce syscon node for both 55xx/56xx/67xx

Example:
	edac_l2: edac_l2 {
	        compatible = "intel,cortex-a57-cpu";
	        syscon = <&syscon>;
	        status = "disabled";
	};
```

## Documentation/devicetree/bindings/arm/axxia/edac_l2.txt
```
Axxia Error Detection & Correction [EDAC]
The EDAC accesses ARM v7/v8 L2MERRSR_EL1 register data.

Required properties:
- compatible	: should contain "intel,cortex-a57-l2-cache" for AXM56xx
		: should contain "lsi,cortex-a15-l2-cache" for AXM55xx
- syscon	: should referernce syscon node for both 55xx/56xx

Example:
	edac_l2: edac_l2 {
	        compatible = "intel,cortex-a57-l2-cache";
	        syscon = <&syscon>;
	        status = "disabled";
	};
```

## Documentation/devicetree/bindings/arm/axxia/edac_l3.txt
```
Axxia Error Detection & Correction [EDAC]
The EDAC accesses a range of registers in the dickens l3 controller

Required properties:
- compatible : should contain "intel,ccn504-l3-cache"
- reg : should contain address of ccn first node; its range shall contain
	all ccn nodes registers ( 0x1000000 ).
- interrupts : if given driver uses interrupts, if not poll mechanism applies

Example:
	edac_l3: edac_l3 {
		compatible = "intel,ccn504-l3-cache";
		reg = <0x80 0x00000000 0 0x1000000>;
		interrupts = <0 256 4>;
		syscon = <&syscon>;
		status = "disabled";
	};
```

## Documentation/devicetree/bindings/arm/marvell/cn913x.txt
```
Marvell OcteonTX2 CN913X Platforms Device Tree Bindings
-------------------------------------------------------

Boards using a SoC of the Marvell CN913X families must carry the following
root node property:

 - compatible, with one of the following values:

SoC:
   - "marvell,cn9130", "marvell,armada-ap807-quad", "marvell,armada-ap807"
      when the SoC being used is the CN9130

Boards:
   - "marvell,cn9130-db-A"
      when the board being used is the OcteonTX2 CN9130 Development board with
      Setup A.

   - "marvell,cn9131-db-A"
      when the board being used is the OcteonTX2 CN9131 Development board with
      Setup A.

Example:

compatible = "marvell,cn9131-db-A", "marvell,cn9131-db",
	     "marvell,armada-ap807-quad", "marvell,armada-ap807";
```

## Documentation/devicetree/bindings/hwrng/axxia_rng.txt
```
AXXIA TRNG HWRNG Driver Module

Required properties:

- compatible : Should contain entries for this.
  - "lsi,trng" for AXXIA devices
- reg : Offset and length of the register set for the module
- interrupts : the interrupt number for the TRNG module.

Example:
trng: trng@8031060000 {
	compatible = "lsi,trng";
	reg = <0x80 0x31060000 0x20000>;
	interrupts = <GIC_SPI 4 IRQ_TYPE_LEVEL_HIGH>;
};
```

## Documentation/devicetree/bindings/misc/axxia-mtc.txt
```
* INTEL Axxia Master Test Controller (MTC)

Required properties:
- compatible : Should be "axxia,mtc"
- reg : Address and length of the register set for the device
  registers)
- interrupts : Should contain MTC interrupt


Example:
mtc: mtc@8080210000 {
		compatible = "axxia,mtc";
		reg = <0x80 0x80210000 0x10000>;
		interrupts = <GIC_SPI 28 IRQ_TYPE_LEVEL_HIGH>;
};
```

## Documentation/devicetree/bindings/net/axxia-femac.txt
```
* INTEL Axxia Fast Ethernet Controller (FEMAC)

Required properties:
- compatible : Should be "axxia,femac"
- reg : Address and length of the register set for the device (RX, TX and DMA
  registers)
- interrupts : Should contain FEMAC DMA interrupt

Optional properties:
- local-mac-address or mac-address: 6 bytes, mac address

Example:

ethernet@2010120000 {
	compatible = "axxia,femac";
	reg = <0x20 0x10120000 0 0x1000>,
	      <0x20 0x10121000 0 0x1000>,
	      <0x20 0x10122000 0 0x1000>;
	interrupts = <0 4 4>;
};
```

## Documentation/devicetree/bindings/net/lsi-mdio.txt
```
* LSI Fast Ethernet Controller (FEMAC)

Required properties:
- compatible : Should be "lsi,axm-mdio"
- reg : Address and length of the register set.
- #address-cells : Must be 1.
- #size-cells : Must be 0.

Optional properties:
- lsi,mdio-clk-offset : Set value used to offset the MDIO output signal. A
value of N means the MDIO output signal is held for (N + 1) clk_per units long.
- lsi,mdio-clk-period : Set value used to offset the MDC signal. A value of N
means the MDC signal is 2 x (N + 1) clk_per units long.

Example:

mdio@2010090000 {
	compatible = "lsi,axm-mdio";
	reg = <0x20 0x10090000 0 0x1000>;
	#address-cells = <1>;
	#size-cells = <0>;

	phy0: ethernet-phy@1e {
		reg = <0x1e>;
	};
};
```

## Documentation/devicetree/bindings/net/marvell-armada-giu-nic-uio.txt
```
* Marvell Armada GIU NIC UIO

This entry is used by the generic platform uio driver (uio_pdrv_genirq) for:
1) mapping the gnic configuration registers to user-space.
2) mapping the msi registers to user-space.

required properties:
=========================
- compatible: should be "marvell,armada-giu-nic-uio"
- reg: addresses and length of the register set for the device (must be at the same range as configured for
  "marvell,armada-giu-nic" entry).
  This is a set of two registers used by the management application to pass the base address of the configuration memory
  space.
  it also contains the msi registers space (which is used by the user-space to generate interrupts to host side).
- reg-names: the namespace for each one of the mappings, specified in 'reg' property.

Example:

uio_agnic_0 {
	compatible = "marvell,armada-giu-nic-uio";
	reg = <0x6F0000 0x1000
	       0x280000 0x1000>;
	reg-names = "agnic_regs", "msi_regs";
	dma-coherent;
	status = "okay";
};
```

## Documentation/devicetree/bindings/net/marvell-armada-giu-nic.txt
```
* Marvell Armada GIU NIC (agnic)

This entry is used by the loadable agnic driver (maintained out of the Linux tree)

required properties:
=========================
- compatible: should be "marvell,armada-giu-nic"
- reg: addresses and length of the register set for the device.
  This is a set of two registers used by the management application to pass the base address of the configuration memory
  space.

Example:

agnic-plat {
	compatible = "marvell,armada-giu-nic";
	reg = <0x6F00A0 0x8>;
	msi-parent = <&gic_v2m0>;
	dma-coherent;
	status = "okay";
};
```

## Documentation/devicetree/bindings/pci/intel,axxia-pcie.txt
```
* Intel Axxia Designware PCIe interface

Required properties:
- compatible: should contain "axxia,axxia-pcie" to identify the core.
- reg: Should contain the DBI, AXI GPREG and CC GPREG address space.
- reg-names: Must be "dbi" for the DBI, "axi_gpreg" for
	AXI GPREG and "cc_gpreg" for CC GPREG address space.
- #address-cells: set to <3>
- #size-cells: set to <2>
- device_type: set to "pci"
- ranges: ranges for the PCI config, outbound memory and I/O regions
- #interrupt-cells: set to <1>
- num-lanes: number of lanes to use

Example:
	pci0: pcie@c000000000 {
		compatible = "axxia,axxia-pcie";
		device_type = "pci";
		reg = <0xa0 0x02000000 0x00100000 /* dbi */
			0xa0 0x03000000 0x00008000 /* AXI gpreg */
			0xa0 0x03008000 0x00008000>; /* CC gpreg */
		reg-names = "dbi", "axi_gpreg", "cc_gpreg";
		#interrupt-cells = <1>;
		#address-cells = <3>;
		#size-cells = <2>;
		num-lanes = <1>;
		ranges = <0x00000000 0x000000c0 0x40000000
			  0xc0 0x40000000
			  0x00 0x10000000         /* config space */
			  0x03000000 0x00000000 0xa0000000
			  0xc0 0x00000000
			  0x00 0x40000000>;       /* outbound mem */
		interrupts = <GIC_SPI 123 IRQ_TYPE_LEVEL_HIGH>;
		status = "disabled";
	};
```

## Documentation/devicetree/bindings/power/reset/axxia-reset.txt
```
INTEL Axxia Restart Driver

This driver can do reset of the Axxia SoC. It uses the registers in the syscon
block to initiate a chip reset.

Required Properties:
  -compatible: "axxia,axm55xx-reset"
  -syscon: phandle to the syscon node.

Example:

	syscon: syscon@2010030000 {
		compatible = "axxia,axxia-syscon", "syscon";
		reg = <0x20 0x10030000 0 0x2000>;
	};

	reset: reset@2010031000 {
		compatible = "axxia,axm55xx-reset";
		syscon = <&syscon>;
	};
```

## Documentation/devicetree/bindings/rapidio/intel,axxia-rapidio.txt
```
* Intel Axxia Designware Serial RapidIO interface

Required properties:
- compatible: should contain "axxia,axxia-rapidio" to identify the core.
- reg: Should contain the sRIO Register address space.
- #address-cells: set to <2>
- #size-cells: set to <2>
- device_type: set to "rapidio"
- ranges: ranges for the SRIO config, outbound memory and I/O regions
- #interrupt-cells: set to <1>
- num-lanes: number of lanes to use

Example:
	rio0: rapidio@0xb000000000 {
		index = <0>;
		compatible = "axxia,axxia-rapidio";
		device_type = "rapidio";
		reg = <0xa0 0x00020000 0 0x00001000>;
		#address-cells = <2>;
		#size-cells = <2>;
		ranges = <0x0 0x0 0x00b0 0x00000000 0x0 0x40000000>;
		linkdown-reset = <0x0200 0x100 0x00a0 0x10000000
							0x0 0x000010000>;
		interrupts = <GIC_SPI 129 IRQ_TYPE_LEVEL_HIGH>;
		outb-dmes = <2 0x00000003 1 0x00000000>;
		enable_ds = <1>;
		status = "disabled";
	};
```

## Documentation/devicetree/bindings/spi/spidev.txt
```
Generic SPI device

Required properties:
- compatible : should be "spidev"
- reg : offset and length of the register set for the device
Optional properties:

Example:
        icm@0 {
                #address-cells = <0x1>;
                #size-cells = <0x1>;
                compatible = "spidev";
                reg = <0x1>;
                spi-max-frequency = <0xf4240>;
                pl022,com-mode = <0x1>;
        };
```

## Documentation/devicetree/bindings/usb/intel,axxia-dwc3.txt
```
Intel Axxia DWC3 USB SoC controller

Required properties:
- compatible:	should contain "axxia,axxia-dwc3"

Required child node:
A child node must exist to represent the core DWC3 IP block. The content
of the node is defined in dwc3.txt.

	usb0: usb@9000000000 {
		compatible = "axxia,axxia-dwc3";
		dma-coherent;
		status = "disabled";
		#address-cells = <2>;
		#size-cells = <1>;
		ranges;
		dwc3 {
			compatible = "synopsys,dwc3";
			reg = <0x90 0x00000000 0x10000>;
			interrupts = <GIC_SPI 90 IRQ_TYPE_LEVEL_HIGH>;
		};
	};
```

## arch/arm/mach-axxia/Kconfig
```kconfig
# SPDX-License-Identifier: GPL-2.0
menu "Axxia platform type"
	depends on ARCH_AXXIA

config ARCH_AXXIA_GIC
        bool "Multi-cluster ARM GIC support for the LSI Axxia platforms"
        select IRQ_DOMAIN
        select MULTI_IRQ_HANDLER
	help
	  The LSI Axxia platforms can have up to four clusters, each having
	  four cores (so a total of 16 cores). This requires the use of a
	  distributed interrupt system in lieu of of a single ARM GIC.

	  This option enables support for this multi-cluster setup.

config ARCH_AXXIA_DT
	bool "Device Tree support for LSI Axxia platforms"
	select ARCH_AXXIA_GIC
	select ARM_PATCH_PHYS_VIRT
	select AUTO_ZRELADDR
	select CPU_V7
	select HAVE_SMP
	select MIGHT_HAVE_CACHE_L2X0
	select USE_OF
	help

	  The LSI Axxia platforms require a Flattened Device Tree to be passed
	  to the kernel.

	  If your bootloader supports Flattened Device Tree based booting,
	  say Y here.

config ARCH_AXXIA_NCR_RESET_CHECK
    bool "Axxia NCR driver reset checking"
    help
      Enabling this option will allow the Axxia NCA Config Ring driver to
      coordinate with the RTE ncp driver to detect when NCA hardware is
      being held in reset.

endmenu
```

## drivers/mtd/nand/Kconfig
```kconfig
config MTD_NAND_CORE
	tristate

config MTD_NAND_EP501X
	tristate "Driver for Eureka EP501/EP501G1/EP501G3 Controllers"
	depends on MTD_NAND
	help
	  Enables NAND flash support for the Eureka EP501, EP501G1
	  and EP501G3 controllers.

config MTD_NAND_EP501X_UBOOTENV
	tristate "U-Boot Environment Access for LSI's APP and ACP"
	depends on ( MTD_NAND_EP501X && CRC32 )
	help
	  Add U-Boot environment access on LSI's APP/ACP boards.

source "drivers/mtd/nand/onenand/Kconfig"

source "drivers/mtd/nand/raw/Kconfig"
```

## drivers/net/ethernet/axxia/Kconfig
```kconfig
config AXXIA_NET
	bool "INTEL Axxia ACP34XX Ethernet support"
	depends on ARM || 44x
	select MII
	select PHYLIB
	default y
	help
	  Network interface driver for INTEL Axxia's 3000 and 5500
	  series boards.

if AXXIA_NET

config AXXIA_NET_NUM_RX_DESC
	int "INTEL Axxia Network Driver: Number of receive descriptors"
	depends on AXXIA_NET
	default "4"
	help
          The number of receive descriptors to allocate.

config AXXIA_NET_RX_BUF_SZ
	int "NIC driver: Size of the receive buffer"
	depends on AXXIA_NET
	default "32768"
	help
          The size of the receive buffer.

config AXXIA_NET_NUM_TX_DESC
	int "NIC driver: Number of transmit descriptors"
	depends on AXXIA_NET
	default "4"
	help
	  The number of transmit descriptors to allocate.

config AXXIA_NET_TX_BUF_SZ
	int "NIC driver: Size of the transmit buffer"
	depends on AXXIA_NET
	default "32768"
	help
	  The size of the transmit buffer.

endif # AXXIA_NET
```
