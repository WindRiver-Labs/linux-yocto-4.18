## drivers/net/ethernet/lsi/Kconfig
```kconfig
config NET_VENDOR_LSI
	bool "LSI AXM55xx Ethernet support"
	select MII
	select PHYLIB
	default y if ARCH_AXXIA
	---help---
	If you have a network interface driver for LSI AXXIA series, say Y

	Note that the answer to this question doesn't directly affect the
	kernel: saying N will just cause the configurator to skip all
	the questions about LSI devices. If you say Y, you will be
	asked for your specific card in the following questions.

if NET_VENDOR_LSI

config NET_LSI_MDIO
	bool "LSI AXM55xx MDIO bus driver"
	default y
	---help---
	  The MDIO controller in AXM55xx devices.

	  If your board uses an external PHY connected to FEMAC, say Y.

config NET_LSI_FEMAC
	tristate "LSI FEMAC Ethernet controller"
	select LSI_MDIO
	default y
	---help---
	  Say Y here if you want to use the built-in 10/100 Fast ethernet
	  controller (FEMAC) on the AXM55xx devices.

endif # NET_VENDOR_LSI


config LSI_NET
	bool "LSI ACP34XX Ethernet support"
	select MII
	select PHYLIB
	help
	  Network interface driver for LSI's APP and AXXIA series boards.

if LSI_NET

config LSI_NET_NUM_RX_DESC
	int "LSI Axxia Network Driver: Number of receive descriptors"
	depends on LSI_NET
	default "4"
	help
          The number of receive descriptors to allocate.

config LSI_NET_RX_BUF_SZ
	int "NIC driver: Size of the receive buffer"
	depends on LSI_NET
	default "32768"
	help
          The size of the receive buffer.

config LSI_NET_NUM_TX_DESC
	int "NIC driver: Number of transmit descriptors"
	depends on LSI_NET
	default "4"
	help
	  The number of transmit descriptors to allocate.

config LSI_NET_TX_BUF_SZ
	int "NIC driver: Size of the transmit buffer"
	depends on LSI_NET
	default "32768"
	help
	  The size of the transmit buffer.

endif # LSI_NET
```

## drivers/rapidio/devices/axxia/Kconfig
```kconfig
config AXXIA_RIO
       bool "AXXIA Embedded SRIO Controller support"
       depends on RAPIDIO && (ACP || ARCH_AXXIA)
       default "n"
       ---help---
         Include support for RapidIO controllers for INTEL Axxia
         devices. The Axxia devices with arm (AXM55xx) and
         powerpc (AXM35xx) cores has the serial RapidIO
         controllers.

config RIO_MAINT_WIN_SIZE
       hex "RIO mport maintenance window size"
       depends on RAPIDIO
       default "0x400000"
       ---help---
         Size of RAPIDIO maintenance transaction window.
         If RapidIO LAW size in your platform is less than 0x400000,
         you may use this option to adjust the maintenance transaction
         window accordingly.

config AXXIA_RIO_STAT
       bool "AXXIA RIO driver statistics"
       depends on AXXIA_RIO
       default n
       ---help---
         If you say Y here, you will be able to measure and view
         state and interrupt counters for the Axxia RapidIO
         controller via sysfs. It provides the counters for mbox
         messages. May add a slght cpu overhead.

config AXXIA_RIO_16B_ID
       bool "RapidIO large common transport system"
       depends on AXXIA_RIO && (ACP && PPC)
       default n
       ---help---
         Say yes here to enable use of 16 bit transport ID otherwise
         transport ID has 8 bits. This is required only for older
         Axxia devices (34xx). And not required for the newer AXM55xx
         devices.

config OB_DME_ENTRY_SIZE
       int "Number of Descriptors per DME for Static allocation"
       depends on AXXIA_RIO
       default "4096"
       ---help---
         Number of Descriptors to allocate for each outbound DME.
```

## drivers/staging/fsl-dpaa2/Kconfig
```kconfig
#
# Freescale DataPath Acceleration Architecture Gen2 (DPAA2) drivers
#

config FSL_DPAA2
	bool "Freescale DPAA2 devices"
	depends on FSL_MC_BUS
	---help---
	  Build drivers for Freescale DataPath Acceleration
	  Architecture (DPAA2) family of SoCs.

config FSL_DPAA2_ETH
	tristate "Freescale DPAA2 Ethernet"
	depends on FSL_DPAA2 && FSL_MC_DPIO
	depends on NETDEVICES && ETHERNET
	---help---
	  Ethernet driver for Freescale DPAA2 SoCs, using the
	  Freescale MC bus driver

if FSL_DPAA2_ETH
config FSL_DPAA2_ETH_USE_ERR_QUEUE
	bool "Enable Rx error queue"
	default n
	---help---
	  Allow Rx error frames to be enqueued on an error queue
	  and processed by the driver (by default they are dropped
	  in hardware).
	  This may impact performance, recommended for debugging
	  purposes only.

# QBMAN_DEBUG requires some additional DPIO APIs
config FSL_DPAA2_ETH_DEBUGFS
	depends on DEBUG_FS && FSL_QBMAN_DEBUG
	bool "Enable debugfs support"
	default n
	---help---
	  Enable advanced statistics through debugfs interface.
endif

source "drivers/staging/fsl-dpaa2/mac/Kconfig"
source "drivers/staging/fsl-dpaa2/evb/Kconfig"

config FSL_DPAA2_ETHSW
	tristate "Freescale DPAA2 Ethernet Switch"
	depends on FSL_DPAA2
	depends on NET_SWITCHDEV
	---help---
	Driver for Freescale DPAA2 Ethernet Switch. Select
	BRIDGE to have support for bridge tools.

config FSL_DPAA2_PTP_CLOCK
	tristate "Freescale DPAA2 PTP Clock"
	depends on FSL_DPAA2_ETH && POSIX_TIMERS
	select PTP_1588_CLOCK
	help
	  This driver adds support for using the DPAA2 1588 timer module
	  as a PTP clock.
```
