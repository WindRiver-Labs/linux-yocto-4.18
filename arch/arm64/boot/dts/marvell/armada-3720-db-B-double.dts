// SPDX-License-Identifier: (GPL-2.0+ OR MIT)
/*
 * Device Tree file for Marvell Armada 3720 development board
 * This board file supports the B configuration of the board
 * Where Eth1 and Eth0 are kernel-space
 */

#include "armada-3720-db-B.dts"

/* Set Eth0 as Kernel port */
&eth0 {
	/delete-property/musdk-status;
};

/* Set Eth1 as Kernel port */
&eth1 {
	/delete-property/musdk-status;
};
