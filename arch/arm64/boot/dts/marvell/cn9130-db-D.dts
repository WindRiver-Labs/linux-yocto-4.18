// SPDX-License-Identifier: (GPL-2.0+ OR MIT)
/*
 * Copyright (C) 2019 Marvell Technology Group Ltd.
 *
 * Device Tree file for Marvell CN9130 Development board. This file supports
 * option D configuration, which is the same as "cn9130-db-A.dts" but with
 * internal phy-mode configuration.
 */

#include "cn9130-db-A.dts"

/ {
	model = "Model: Marvell CN9130 development board (CP NOR) setup(D)";
	compatible = "marvell,cn9130-db-D", "marvell,armada-ap807-quad",
		     "marvell,armada-ap807";
};

&cp0_eth0 {
	phy-mode = "internal";
};
