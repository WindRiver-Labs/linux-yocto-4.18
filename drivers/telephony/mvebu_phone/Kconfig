## drivers/telephony/mvebu_phone/Kconfig
```kconfig
config MV_TDM_EXT_STATS
	bool "Enable legacy TDM extended statistics"
	depends on MACH_ARMADA_38X
	default y
	---help---
	  Choosing this option will export
	  extended statistics to procfs.
	  This is relevant only for the
	  legacy TDM unit.

config MV_PHONE_SPI_DEBUG
	bool "Enable SLIC SPI debug"
	default n
	---help---
	  Choosing this option will enable
	  printing debug information
	  about all data sent to and from
	  SLIC device via SPI interface.
```
